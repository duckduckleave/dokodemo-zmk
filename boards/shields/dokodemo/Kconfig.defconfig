## boards/shields/dokodemo/Kconfig.defconfig
```kconfig
if SHIELD_DOKODEMO_LEFT

# Name must be less than 16 characters long!
config ZMK_KEYBOARD_NAME
    default "DokoDemo"

config ZMK_SPLIT_ROLE_CENTRAL
    default y

config ZMK_SPLIT_BLE_CENTRAL_PERIPHERALS
  default 1

config BT_MAX_CONN
  default 6

config BT_MAX_PAIRED
  default 6

endif

if SHIELD_DOKODEMO_LEFT || SHIELD_DOKODEMO_RIGHT

config ZMK_SPLIT
    default y

endif

if SHIELD_DOKODEMO_DONGLE

# Name must be less than 16 characters long!
config ZMK_KEYBOARD_NAME
    default "DokoDemo"

config ZMK_SPLIT
    default y

config ZMK_SPLIT_ROLE_CENTRAL
    default y

config ZMK_SPLIT_BLE_CENTRAL_PERIPHERALS
  default 2

config BT_MAX_CONN
  default 7

config BT_MAX_PAIRED
  default 7

endif
```

## boards/shields/dokodemo/Kconfig.shield
```kconfig
config SHIELD_DOKODEMO_LEFT
    def_bool $(shields_list_contains,dokodemo_left)
  
config SHIELD_DOKODEMO_RIGHT
    def_bool $(shields_list_contains,dokodemo_right)
  
config SHIELD_DOKODEMO_DONGLE
    def_bool $(shields_list_contains,dokodemo_dongle)
```

## boards/shields/dokodemov0/Kconfig.defconfig
```kconfig
if SHIELD_DOKODEMOV0_LEFT

# Name must be less than 16 characters long!
config ZMK_KEYBOARD_NAME
    default "DokoDemoV0"

config ZMK_SPLIT_ROLE_CENTRAL
    default y

config ZMK_SPLIT_BLE_CENTRAL_PERIPHERALS
  default 1

config BT_MAX_CONN
  default 6

config BT_MAX_PAIRED
  default 6

endif

if SHIELD_DOKODEMOV0_LEFT || SHIELD_DOKODEMOV0_RIGHT

config ZMK_SPLIT
    default y

endif

if SHIELD_DOKODEMOV0_DONGLE

# Name must be less than 16 characters long!
config ZMK_KEYBOARD_NAME
    default "DokoDemoV0"

config ZMK_SPLIT
    default y

config ZMK_SPLIT_ROLE_CENTRAL
    default y

config ZMK_SPLIT_BLE_CENTRAL_PERIPHERALS
  default 2

config BT_MAX_CONN
  default 7

config BT_MAX_PAIRED
  default 7

endif
```

## boards/shields/dokodemov0/Kconfig.shield
```kconfig
config SHIELD_DOKODEMOV0_LEFT
    def_bool $(shields_list_contains,dokodemov0_left)
  
config SHIELD_DOKODEMOV0_RIGHT
    def_bool $(shields_list_contains,dokodemov0_right)
  
config SHIELD_DOKODEMOV0_DONGLE
    def_bool $(shields_list_contains,dokodemov0_dongle)
```

## config/west.yml
```yaml
manifest:
  defaults:
    revision: 6e2ef41e022d555b10f116e395832913f71717b3
  remotes:
    - name: zmkfirmware
      url-base: https://github.com/zmkfirmware
    # Additional modules containing boards/shields/custom code can be listed here as well
    # See https://docs.zephyrproject.org/3.2.0/develop/west/manifest.html#projects
  projects:
    - name: zmk
      remote: zmkfirmware
      import: app/west.yml
    - name: zmk-rgbled-widget
      url: https://github.com/caksoylar/zmk-rgbled-widget
      revision: e6b467792a1dabef8cfa5c9fd26bfefc9c16662b
  self:
    path: config
```
